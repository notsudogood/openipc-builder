## package/mabur/Config.in
```kconfig
config BR2_PACKAGE_MABUR
	bool "mabur"
	default n
	select BR2_PACKAGE_LIBUSB
	select BR2_PACKAGE_DEVOURER
	help
	  RTP-free FPV video link, drone side. maburd drives the SigmaStar
	  MI encoder in-process, applies per-layer RS UEP FEC + SBI framing,
	  and injects over a Realtek 8812EU or 8812CU via the devourer userspace
	  driver, with adaptive-link (RCF/DISC) feedback, air-clock pacing
	  and MAX_RANGE failsafe. One daemon: the separate encoder process
	  was folded into maburd, which drives the SigmaStar MI encoder
	  in-process.

	  https://github.com/gilankpam/mabur

if BR2_PACKAGE_MABUR

choice
	prompt "Radio card"
	default BR2_PACKAGE_MABUR_RADIO_8812EU
	help
	  The one Realtek chip maburd's devourer is built for. Exactly one:
	  each chip carries its own firmware + PHY/halrf tables (stripped
	  maburd, 2026-09-26: 8822E 1.08 MB, 8822C 1.27 MB, both 1.70 MB)
	  and the board carries one card. maburd on the wrong card fails
	  at CreateRtlDevice ("unsupported chip").

config BR2_PACKAGE_MABUR_RADIO_8812EU
	bool "RTL8812EU (devourer rtl8822e)"
	help
	  OpenIPC URLLC AIO, RunCam WiFiLink 2 and clones.

config BR2_PACKAGE_MABUR_RADIO_8812CU
	bool "RTL8812CU (devourer rtl8822c)"
	help
	  EMAX Wyvern Link Alpha.

endchoice

config BR2_PACKAGE_MABUR_INPROC_VENC
	bool "In-process SigmaStar encoder (SSC338Q)"
	default y
	help
	  maburd drives the camera and H.265 encoder itself through the
	  infinity6e MI libraries (waybeam's star6e pipeline folded in).
	  The SSC338Q images. Say n on an SSC378QE (infinity6c) image: that
	  SDK has no VPE and a different MI ABI, so there the encoder is
	  waybeam_venc's Maruko backend as a separate process
	  (BR2_PACKAGE_WAYBEAM_VENC), feeding maburd over the frame-shm
	  ring and taking its bitrate/fps/keyframe asks over HTTP. Without
	  the in-process encoder maburd has no Camera-tab presets, no
	  onboard (VTX) recording and no phase-lock sensor steering.

config BR2_PACKAGE_MABUR_MSP_SERIAL
	string "Flight-controller UART"
	default "/dev/ttyS2"
	help
	  Written into the image's /etc/mabur.toml as [msp] serial, so a
	  fresh flash (and the config refresh on every new image) reads the
	  flight controller on the right port. /dev/ttyS2 on the OpenIPC
	  URLLC AIO; /dev/ttyS3 on the EMAX Wyvern Link Alpha.

endif
```

## package/waybeam-venc/Config.in
```kconfig
config BR2_PACKAGE_WAYBEAM_VENC
	bool "waybeam-venc (Maruko: the SSC378QE camera + encoder for maburd)"
	default n
	depends on BR2_PACKAGE_SIGMASTAR_OSDRV_INFINITY6C
	help
	  Upstream OpenIPC waybeam_venc built for its Maruko backend
	  (SigmaStar Infinity6C: SSC378QE), as its own process. It drives
	  the sensor, ISP and H.265 encoder through the MI libraries
	  sigmastar-osdrv-infinity6c installs, publishes whole encoded
	  frames into the frame-shm ring /mabur_f, and takes its live
	  settings (bitrate, fps, keyframe requests) over its HTTP API on
	  127.0.0.1:80. maburd built with BR2_PACKAGE_MABUR_INPROC_VENC=n
	  is the consumer of both.

	  Only for the SSC378QE images: the SSC338Q images carry mabur's
	  folded-in encoder and must not select this.

	  https://github.com/OpenIPC/waybeam_venc
```
